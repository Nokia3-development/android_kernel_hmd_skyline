## drivers/input/fingerprint/Kconfig
```kconfig
menu "Device Drivers"

config INPUT_FP
	tristate "input fp"
    default n

source "drivers/input/fingerprint/silead/Kconfig"

endmenu
```

## drivers/misc/battery_info/Kconfig
```kconfig
#
# for battery sn validate
#

config BATTERY_INFO
	tristate "check battery info status"
	help
	  this will create a node to show battery info status.

	  If unsure, say N.
```

## drivers/misc/sim_tray/Kconfig
```kconfig
#
# for huaqin mis info
#

config CUSTOM_SIM_TRAY_CHECK
	tristate "check sim stry status"
	help
	  this will create a node to show sim tray status.

	  If unsure, say N.
```

## drivers/misc/sim_tray_detect/Kconfig
```kconfig
config SIM_TRAY_DETECT
	tristate "check sim tray detect status"
	help
	  this will create a node to show sim tray status.

	  If unsure, say N.
```

## hmd/Kconfig
```kconfig
#
# Generate for samsung config
#

config ARCH_TOMCAT
	bool "Enable Support for Qualcomm Technologies, Inc. PARROT"
	depends on ARCH_QCOM
	help
	  This enables support for the Qualcomm Technologies, Inc.'s
	  DIWALI chipset. If you do not wish to build a kernel that
	  runs on this chipset or if you are unsure, say 'N' here.

config CUSTOM_FACTORY_BUILD
	bool "Enable custom factory build"

config CUSTOM_D85_BUILD
	bool "Enable custom D85 build"
```
